## main/Kconfig.projbuild
```kconfig
menu "Example Configuration"

    config EXAMPLE_FIRMWARE_UPGRADE_URL
        string "Firmware Upgrade URL"
        default "https://github.com/berkeroptoel/CANforwarder/raw/main/advanced_https_ota.bin"
        help
            URL of server which hosts the firmware image.

    config EXAMPLE_FIRMWARE_UPGRADE_URL_FROM_STDIN
        bool
        default y if EXAMPLE_FIRMWARE_UPGRADE_URL = "FROM_STDIN"

    config EXAMPLE_SKIP_COMMON_NAME_CHECK
        bool "Skip server certificate CN fieldcheck"
        default n
        help
            This allows you to skip the validation of OTA server certificate CN field.

    config EXAMPLE_SKIP_VERSION_CHECK
        bool "Skip firmware version check"
        default n
        help
            This allows you to skip the firmware version check.

    config EXAMPLE_OTA_RECV_TIMEOUT
        int "OTA Receive Timeout"
        default 5000
        help
            Maximum time for reception

    config EXAMPLE_ENABLE_PARTIAL_HTTP_DOWNLOAD
        bool "Enable partial HTTP download"
        default n
        help
            This enables use of Range header in esp_https_ota component.
            Firmware image will be downloaded over multiple HTTP requests.

    config EXAMPLE_HTTP_REQUEST_SIZE
        int "HTTP request size"
        default MBEDTLS_SSL_IN_CONTENT_LEN
        depends on EXAMPLE_ENABLE_PARTIAL_HTTP_DOWNLOAD
        help
            This options specifies HTTP request size. Number of bytes specified
            in this option will be downloaded in single HTTP request.
            
	config BROKER_URL
		string "Broker URL"
		default "mqtt://broker.emqx.io"
		help
			URL of the broker to connect to
	
	choice OP_MODE
		prompt "OPERATING MODE"
		default MODE_FAST_SEND_MQTT
		help
			Select operating mode of the device
		config MODE_FAST_SEND_MQTT
			bool "MODE_FAST"
			help 
				When any CAN frame is received, this frame is sent to broker instantly 
		
		config MODE_SLOW_SEND_MQTT
			bool "MODE_SLOW"
			help
				CAN frames is received amount of %50 total buffer size, then frames are sent to broker all together
		
		config MODE_TRIGGER_SEND_MQTT
			bool "MODE_TRIGGER"
			help
				CAN frames are logged to SPIFFS, as soon as get command is received from MQTT broker, then LOGS are sent to broker all together 		 	
	endchoice
	
	config PRINT_CAN_FRAME_INFO  
			bool "Output the received CAN FRAME to STDOUT"
			default y
			help 
				Output the received CAN FRAME to STDOUT.	
				
endmenu
```
